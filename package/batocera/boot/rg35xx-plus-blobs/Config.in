## package/batocera/boot/rg35xx-plus-blobs/Config.in
```kconfig
config BR2_PACKAGE_RG35XX_PLUS_BLOBS
	bool "rg35xx-plus-blobs"
	help
	  RG35XX Plus boot blobs
```

## package/batocera/firmwares/firmware-rg35xx-plus/Config.in
```kconfig
config BR2_PACKAGE_FIRMWARE_RG35XX_PLUS
	bool "firmware-rg35xx-plus"
	help
	  RG35XX Plus firmware
```

## package/batocera/kernel/rg35xx-plus-modules/Config.in
```kconfig
config BR2_PACKAGE_RG35XX_PLUS_MODULES
	bool "rg35xx-plus-modules"
	help
	  RG35XX Plus kernel modules
```
